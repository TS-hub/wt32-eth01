## sdkconfig.defaults
```kconfig
# Waveshare ESP32-S3-ETH: W5500 via SPI
CONFIG_EXAMPLE_USE_SPI_ETHERNET=y
CONFIG_EXAMPLE_USE_W5500=y
CONFIG_EXAMPLE_SPI_ETHERNETS_NUM=1
CONFIG_EXAMPLE_ETH_SPI_HOST=1
CONFIG_EXAMPLE_ETH_SPI_SCLK_GPIO=13
CONFIG_EXAMPLE_ETH_SPI_MOSI_GPIO=11
CONFIG_EXAMPLE_ETH_SPI_MISO_GPIO=12
CONFIG_EXAMPLE_ETH_SPI_CS0_GPIO=14
CONFIG_EXAMPLE_ETH_SPI_INT0_GPIO=10
CONFIG_EXAMPLE_ETH_SPI_PHY_RST0_GPIO=9
CONFIG_EXAMPLE_ETH_SPI_CLOCK_MHZ=25

# IDF-seitige SPI-Ethernet-Treiber
CONFIG_ETH_ENABLED=y
CONFIG_ETH_USE_SPI_ETHERNET=y
CONFIG_ETH_SPI_ETHERNET_W5500=y

# Stack-Größe für iperf-Tasks
CONFIG_ESP_MAIN_TASK_STACK_SIZE=7168

# FreeRTOS-Statistiken (für 'tasks'-Konsolenbefehl)
CONFIG_FREERTOS_USE_TRACE_FACILITY=y
CONFIG_FREERTOS_USE_STATS_FORMATTING_FUNCTIONS=y

# Flash-Größe: 16 MB
CONFIG_ESPTOOLPY_FLASHSIZE_16MB=y
CONFIG_ESPTOOLPY_FLASHSIZE="16MB"

# Benutzerdefinierte Partitionstabelle (4 MB App)
CONFIG_PARTITION_TABLE_CUSTOM=y
CONFIG_PARTITION_TABLE_CUSTOM_FILENAME="partitions.csv"

# lwIP TCP: größerer Sendepuffer für iperf3-Client-Modus
# Empfangsfenster bleibt bei Standard 5760 — größere Werte überlasten den W5500-MACRAW-Puffer (16 KB)
CONFIG_LWIP_TCP_SND_BUF_DEFAULT=65535
```

## sdkconfig.defaults.esp32s3
```kconfig
# ESP32-S3-spezifisch: maximaler Durchsatz

# CPU auf 240 MHz
CONFIG_ESP_DEFAULT_CPU_FREQ_MHZ_240=y

# Watchdogs während Benchmarks deaktivieren
CONFIG_ESP_INT_WDT=n
CONFIG_ESP_TASK_WDT_EN=n

# IRAM-Optimierung für lwIP
CONFIG_LWIP_IRAM_OPTIMIZATION=y

# OPI PSRAM (8 MB, embedded on ESP32-S3)
CONFIG_SPIRAM=y
CONFIG_SPIRAM_MODE_OCT=y
CONFIG_SPIRAM_SPEED_80M=y
CONFIG_SPIRAM_USE_MALLOC=y
CONFIG_SPIRAM_MALLOC_ALWAYSINTERNAL=16384
```
